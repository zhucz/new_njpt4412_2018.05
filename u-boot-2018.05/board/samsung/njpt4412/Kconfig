## u-boot-2018.05/board/samsung/njpt4412/Kconfig
```kconfig
if TARGET_NJPT4412

config SYS_BOARD
	default "njpt4412"

config SYS_VENDOR
	default "samsung"

config SYS_CONFIG_NAME
	default "njpt4412"

endif
```

## u-boot-2018.05/configs/njpt4412_defconfig
```kconfig
CONFIG_ARM=y
CONFIG_ARCH_EXYNOS=y
CONFIG_SYS_TEXT_BASE=0x43E00000
CONFIG_ARCH_EXYNOS4=y
CONFIG_TARGET_NJPT4412=y
CONFIG_SPL=y
CONFIG_IDENT_STRING=" for NJPT4412"
CONFIG_DEFAULT_DEVICE_TREE="exynos4412-njpt4412"
CONFIG_DISTRO_DEFAULTS=y
# CONFIG_USE_BOOTCOMMAND is not set
CONFIG_SYS_CONSOLE_IS_IN_ENV=y
CONFIG_SYS_CONSOLE_INFO_QUIET=y
# CONFIG_SPL_FRAMEWORK is not set
CONFIG_SYS_PROMPT="NJPT4412 # "
# CONFIG_CMD_XIMG is not set
CONFIG_CMD_THOR_DOWNLOAD=y
CONFIG_CMD_DFU=y
CONFIG_CMD_GPT=y
CONFIG_CMD_MMC=y
CONFIG_CMD_USB_MASS_STORAGE=y
# CONFIG_CMD_NET is not set
CONFIG_CMD_CACHE=y
# CONFIG_CMD_MISC is not set
CONFIG_CMD_EXT4_WRITE=y
CONFIG_OF_CONTROL=y
CONFIG_DFU_MMC=y
CONFIG_DM_MMC=y
CONFIG_MMC_DW=y
CONFIG_MMC_SDHCI=y
CONFIG_MMC_SDHCI_SDMA=y
CONFIG_MMC_SDHCI_S5P=y
CONFIG_USB=y
CONFIG_DM_USB=y
CONFIG_USB_GADGET=y
CONFIG_USB_GADGET_MANUFACTURER="Samsung"
CONFIG_USB_GADGET_VENDOR_NUM=0x04e8
CONFIG_USB_GADGET_PRODUCT_NUM=0x685D
# CONFIG_USB_GADGET_PRODUCT_NUM=0x6601
CONFIG_USBNET_DEVADDR="DE:AD:BE:EF:00:01"

# CONFIG_USB_ETHER_DM9601=y
CONFIG_USB_GADGET_DWC2_OTG=y
CONFIG_USB_GADGET_DOWNLOAD=y
CONFIG_USB_FUNCTION_THOR=y
CONFIG_USB_FUNCTION_DFU=y

# CONFIG_REGEX is not set
# CONFIG_DEBUG_LL=y
# CONFIG_DEBUG_UART_PHYS=0x13820000
# CONFIG_DEBUG_UART_8250_FLOW_CONTROL=y

CONFIG_DM=y
CONFIG_DM_SERIAL=y
CONFIG_DM_GPIO=y
```
